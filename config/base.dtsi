#include <behaviors.dtsi>
#include <dt-bindings/zmk/keys.h>
#include <dt-bindings/zmk/bt.h>

// Layers
#define BASE 0
#define LOWER 1
#define RAISE 2

// Behaviors Constants
#define TAPPING_TERM_MS 200
#define QUICK_TAP_MS 175
#define REQUIRE_PRIOR_IDLE_MS 150

#include "./behaviors.dtsi"
#include "./combos.dtsi"